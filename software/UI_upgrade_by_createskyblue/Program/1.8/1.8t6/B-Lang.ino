#define LANG_JP_State false
/*////////////////////////////////////////////////////////////////////////////////////////////////////
   多语言支持
   Multilingual support
   ///////////////////////////////////////////////////////////////////////////////////////////////////
*/
/*
    英语库  ENGLISH
*/
const char EN_0[] PROGMEM = "Tip";
const char EN_1[] PROGMEM = "Temp";
const char EN_2[] PROGMEM = "Timer";
const char EN_3[] PROGMEM = "Control";
const char EN_4[] PROGMEM = "Screen";
const char EN_5[] PROGMEM = "Buzzer";
const char EN_6[] PROGMEM = "LOW Vol";
const char EN_7[] PROGMEM = "Lang";
const char EN_8[] PROGMEM = "Return";
const char EN_9[] PROGMEM = "Change";
const char EN_10[] PROGMEM = "Calibrate";
const char EN_11[] PROGMEM = "Rename";
const char EN_12[] PROGMEM = "Delete";
const char EN_13[] PROGMEM = "Add";
const char EN_14[] PROGMEM = "Save";
const char EN_15[] PROGMEM = "Default";
const char EN_16[] PROGMEM = "Sleep";
const char EN_17[] PROGMEM = "Boost";
const char EN_18[] PROGMEM = "Save";
const char EN_19[] PROGMEM = "Sleep";
const char EN_20[] PROGMEM = "Off";
const char EN_21[] PROGMEM = "Boost";
const char EN_22[] PROGMEM = "Save";
const char EN_23[] PROGMEM = "Direct";
const char EN_24[] PROGMEM = "PID";
const char EN_25[] PROGMEM = "Big";
const char EN_26[] PROGMEM = "Infos";
const char EN_27[] PROGMEM = "OFF";
const char EN_28[] PROGMEM = "ON";
const char EN_29[] PROGMEM = "NO";
const char EN_30[] PROGMEM = "YES";
const char EN_31[] PROGMEM = "CN";
const char EN_32[] PROGMEM = "EN";
const char EN_33[] PROGMEM = "NO";
const char EN_34[] PROGMEM = "OK";
const char EN_35[] PROGMEM = "Main Screen";
const char EN_36[] PROGMEM = "Flip";
const char EN_37[] PROGMEM = "Save";
const char EN_38[] PROGMEM = "About";
const char EN_39[] PROGMEM = "JP";
const char EN_40[] PROGMEM = "Lock";
const char EN_41[] PROGMEM = "Rotary";

const char *const EN_table[] PROGMEM = {EN_0, EN_1, EN_2, EN_3, EN_4, EN_5, EN_41, EN_6, EN_40, EN_7, EN_38, EN_8, EN_9, EN_10, EN_11, EN_12, EN_13, EN_14, EN_15, EN_16, EN_17, EN_18, EN_19, EN_20, EN_21, EN_22, EN_23, EN_24, EN_25, EN_26, EN_27, EN_28, EN_29, EN_30, EN_31, EN_32, EN_39, EN_35, EN_36, EN_37,};

/*
  #!/usr/bin/python
  # -*- coding: UTF-8 -*-
  for num in range(0,38):
  print("EN_",end="")
  print(num,end='')
  print(",",end="")
*/

/*////////////////////////////////////////////////////////////////////////////////////////////////////
   多语言支持
   Multilingual support
   ///////////////////////////////////////////////////////////////////////////////////////////////////
*/

/*
    中文语言库 CHINESE

  ////////////////////////////////////////////////////////////////////////////////////////////////////////
   本地化提示：你可以按照位图的大小，把这里的文字位图替换成你的语言，确保位图分辨率一致即可，我们欢迎你把程序翻译为你当地的语言！
  Localization tips: you can according to the size of the bitmap,
  replace the text bitmap here with your language,
  ensure that the bitmap resolution is consistent,
  we welcome you to translate the program into your local language!
  ////////////////////////////////////////////////////////////////////////////////////////////////////////
*/
//width:28,height:14 主界面中文提示
//Main Screen
//错误-ERROR
const unsigned char S1[] PROGMEM = { 0x20, 0x92, 0x1f, 0xc0, 0x3d, 0xf9, 0x90, 0x40, 0x20, 0x90, 0x90, 0x40, 0x40,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 0x20, 0x20 };
//关机-OFF
const unsigned char S2[] PROGMEM = { 0x10, 0x40, 0x47, 0xc0, 0x17, 0xfc, 0x44, 0x40, 0x20, 0x03, 0xf4, 0x40, 0x23,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 0x40, 0x00 };
//休眠-SLEEP
const unsigned char S3[] PROGMEM = { 0x10, 0x83, 0xdf, 0xc0, 0x10, 0x82, 0x50, 0x40, 0x20, 0x82, 0x50, 0x40, 0x2f,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 0x10, 0x10 };
//提温-BOOST
const unsigned char S4[] PROGMEM = { 0x23, 0xf2, 0x1f, 0xc0, 0x22, 0x11, 0x10, 0x40, 0xfb, 0xf0, 0x90, 0x40, 0x22,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 0x7f, 0xf0 };
//正常工作-WORKY
const unsigned char S5[] PROGMEM = { 0x7f, 0xf8, 0x48, 0x80, 0x02, 0x00, 0x49, 0x00, 0x02, 0x01, 0xff, 0xf0, 0x02,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 0x08, 0x00 };
//加热-HEAT
const unsigned char S6[] PROGMEM = { 0x0f, 0x42, 0x1f, 0xc0, 0x78, 0x41, 0x10, 0x40, 0x08, 0x40, 0x90, 0x40, 0x08,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 0x7f, 0xf0 };
//维持-HOLD
const unsigned char S7[] PROGMEM = { 0x11, 0x40, 0x82, 0x00, 0x21, 0x20, 0x8f, 0xe0, 0x23, 0xfc, 0x82, 0x00, 0x4a,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 0x01, 0x00 };
const unsigned char *S_table[] = {S1, S2, S3, S4, S5, S6, S7};

// 菜单  width:36,height:16
//MENU Oj
/*
   The order here(↓) can refer to EN_table(↑↑↑)
*/
const unsigned char t0[] PROGMEM = { 0x00, 0x00, 0x00, 0x00, 0x00, 0x1f, 0x7f, 0x90, 0xf8, 0x00, 0x01, 0x08, 0x08,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 0x00, 0x00 };
const unsigned char t1[] PROGMEM  = { 0x00, 0x00, 0x00, 0x00, 0x00, 0x10, 0xfe, 0x08, 0x20, 0x00, 0x08, 0x82, 0x0b,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 0x00, 0x00 };
const unsigned char t2[] PROGMEM  = { 0x00, 0x00, 0x00, 0x00, 0x00, 0x00, 0x20, 0x00, 0x00, 0x00, 0x00, 0x20, 0x3e,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 0x08, 0x00 };
const unsigned char t3[] PROGMEM  = { 0x00, 0x00, 0x00, 0x00, 0x00, 0x04, 0x10, 0x12, 0x02, 0x00, 0x05, 0xff, 0x9f,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 0x00, 0x00 };
const unsigned char t4[] PROGMEM = { 0x00, 0x00, 0x00, 0x00, 0x00, 0x07, 0xfe, 0x0f, 0xf8, 0x00, 0x04, 0x02, 0x00,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 0x00, 0x00 };
const unsigned char t5[] PROGMEM = { 0x00, 0x00, 0x00, 0x00, 0x00, 0x00, 0x40, 0x00, 0x80, 0x00, 0x1f, 0xff, 0x9f,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 0x00, 0x00 };
const unsigned char t6[] PROGMEM = { 0x09, 0xff, 0x00, 0x40, 0x00, 0x04, 0x20, 0x3f, 0xff, 0x00, 0x04, 0x20, 0x00,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 0x00, 0x00 };

const unsigned char t7[] PROGMEM = { 0x00, 0x00, 0x00, 0x00, 0x00, 0x01, 0x00, 0x0f, 0xfe, 0x00, 0x01, 0x00, 0x08,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 0x00, 0x00 };
const unsigned char Back[] PROGMEM = { 0x00, 0x00, 0x00, 0x00, 0x00, 0x10, 0x07, 0x00, 0x00, 0x00, 0x08, 0xf8, 0x3f,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 0x00, 0x00 };

const unsigned char t1_1[] PROGMEM = { 0x00, 0x00, 0x00, 0x00, 0x00, 0x02, 0x08, 0x20, 0x90, 0x00, 0x02, 0x7f, 0x98,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 0x00, 0x00 };
const unsigned char t1_2[] PROGMEM = { 0x00, 0x00, 0x00, 0x00, 0x00, 0x00, 0x20, 0x00, 0x80, 0x00, 0x00, 0x50, 0x01,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 0x00, 0x00 };
const unsigned char t1_3[] PROGMEM = { 0x00, 0x00, 0x00, 0x00, 0x00, 0x0f, 0x78, 0xbc, 0x20, 0x00, 0x09, 0x48, 0xa4,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 0x00, 0x00 };
const unsigned char t1_4[] PROGMEM = { 0x00, 0x00, 0x00, 0x00, 0x00, 0x02, 0x03, 0x00, 0x10, 0x00, 0x1f, 0xdc, 0x3e,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 0x00, 0x00 };
//默认
const unsigned char t2_0[] PROGMEM = { 0x00, 0x00, 0x00, 0x00, 0x00, 0x1f, 0xc8, 0x10, 0x20, 0x00, 0x12, 0x4a, 0x0c,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 0x00, 0x00 };
//休眠
const unsigned char t2_1[] PROGMEM = { 0x00, 0x00, 0x00, 0x00, 0x00, 0x02, 0x10, 0x3d, 0xfc, 0x00, 0x02, 0x10, 0x25,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 0x00, 0x00 };
//提温
const unsigned char t2_2[] PROGMEM = { 0x00, 0x00, 0x00, 0x00, 0x00, 0x04, 0x7e, 0x21, 0xfc, 0x00, 0x04, 0x42, 0x11,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 0x00, 0x00 };
//关机
const unsigned char t3_1[] PROGMEM = { 0x01, 0x04, 0x04, 0x7c, 0x00, 0x00, 0x88, 0x04, 0x44, 0x00, 0x0f, 0xff, 0x3f,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 0x00, 0x00 };

const unsigned char t_4[] PROGMEM = { 0x00, 0x00, 0x00, 0x00, 0x00, 0x00, 0x20, 0x08, 0x20, 0x00, 0x0f, 0xff, 0x09,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 0x00, 0x00 };
const unsigned char t_PID[] PROGMEM = { 0x00, 0x00, 0x00, 0x00, 0x00, 0x0f, 0xc3, 0xf1, 0xe0, 0x00, 0x0f, 0xe3, 0xf1,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 0x00, 0x00 };

const unsigned char t5_0[] PROGMEM = { 0x00, 0x00, 0x00, 0x00, 0x00, 0x07, 0xdf, 0x88, 0x40, 0x00, 0x0a, 0x24, 0x10,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 0x00, 0x00 };
const unsigned char t5_1[] PROGMEM = { 0x00, 0x00, 0x00, 0x00, 0x00, 0x08, 0x44, 0x10, 0xfe, 0x00, 0x04, 0x28, 0x10,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 0x00, 0x00 };
const unsigned char t5_3[] PROGMEM = { 0x00, 0x00, 0x00, 0x00, 0x00, 0x01, 0x08, 0x3f, 0xfe, 0x00, 0x1f, 0xff, 0x81,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 0x00, 0x00 };

const unsigned char t_off[] PROGMEM = { 0x00, 0x00, 0x00, 0x00, 0x00, 0x00, 0x82, 0x04, 0xff, 0x00, 0x00, 0x44, 0x02,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 0x00, 0x00 };
const unsigned char t_on[] PROGMEM = { 0x00, 0x00, 0x00, 0x00, 0x00, 0x07, 0xff, 0x80, 0x20, 0x00, 0x00, 0x84, 0x07,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 0x00, 0x00 };

const unsigned char t_NO[] PROGMEM = { 0x00, 0x00, 0x00, 0x00, 0x00, 0x0f, 0xf0, 0x04, 0x91, 0x00, 0x04, 0x40, 0x02,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 0x00, 0x00 };
const unsigned char t_OK[] PROGMEM = { 0x00, 0x00, 0x00, 0x00, 0x00, 0x1f, 0xdf, 0x10, 0x20, 0x00, 0x02, 0x12, 0x0c,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 0x00, 0x00 };

const unsigned char t_CN_CN[] PROGMEM = { 0x00, 0x00, 0x00, 0x00, 0x00, 0x00, 0x40, 0x00, 0x80, 0x00, 0x00, 0x40, 0x00,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 0x00, 0x00 };
const unsigned char t_CN_EN[] PROGMEM = { 0x00, 0x00, 0x00, 0x00, 0x00, 0x01, 0x10, 0x00, 0x80, 0x00, 0x1f, 0xff, 0x80,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 0x00, 0x00 };
const unsigned char t_CN_JP[] PROGMEM = { 0x00, 0x00, 0x00, 0x00, 0x00, 0x07, 0xfe, 0x13, 0xfe, 0x00, 0x04, 0x02, 0x08,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 0x00, 0x00 };

//翻转
const unsigned char t4f[] PROGMEM = { 0x00, 0x00, 0x00, 0x00, 0x00, 0x0f, 0x1d, 0xc2, 0x08, 0x00, 0x05, 0x44, 0x42,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 0x00, 0x00 };
//保存
const unsigned char t_save[] PROGMEM = { 0x02, 0xfe, 0x01, 0x00, 0x00, 0x02, 0x82, 0x3f, 0xff, 0x00, 0x04, 0x82, 0x02,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 0x00, 0x00 };
const unsigned char tAbout[] PROGMEM = { 0x00, 0x00, 0x00, 0x00, 0x00, 0x00, 0x82, 0x0f, 0xfe, 0x00, 0x00, 0x44, 0x00,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 0x00, 0x00 };
const unsigned char tPassword[] PROGMEM = { 0x00, 0x00, 0x00, 0x00, 0x00, 0x00, 0x40, 0x1f, 0x7e, 0x00, 0x1f, 0xff, 0x84,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 0x00, 0x00 };
const unsigned char t19[] PROGMEM = { 0x00, 0x08, 0x00, 0x00, 0x00, 0x02, 0x1f, 0x88, 0xfe, 0x00, 0x1f, 0xd0, 0x0e,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 0x00, 0x00 };
const unsigned char *CN_table[] = {
  t0, t1, t2, t3, t4, t5, t19 , t7, tPassword, t6, tAbout, Back, //0
  t0, t1_1, t1_2, t1_3, t1_4, t_save,  //1
  t2_0, t2_1, t2_2, t_save, //2
  t2_1, t3_1, t2_2, t_save,//3
  t_4, t_PID,//4
  t5_0, t5_1,//5
  t_off, t_on,//6
  t_NO, t_OK,//7
  t_CN_CN, t_CN_EN, t_CN_JP, //8
  t5_3, t4f, t_save, //9
};

/*
   日语 Japanese
*/
/*
  8x8 dot Japanese font for Arduboy

  Copyright (c) 2016 emutyworks

  Released under the MIT license
  https://github.com/emutyworks/8x8DotJPFont/blob/master/LICENSE.txt
*/


/*
  利用しないフォントデータはヘッダファイルを読み込まないようにするとメモリが節約できます、
  drawText() 実行時にフォントが無い場合は処理がスキップされます。

  例) 8x8 dot ひらがな・カタカナ・記号 のみ利用
  #include "misaki_font_f0.h" // 8x8 dot ひらがな・カタカナ・記号
  //#include "misaki_font_f1.h" // 4x8 dot 英語・カタカナ・記号
  //#include "misaki_font_f2.h" // 8x8 dot 漢字
*/

#if LANG_JP_State
#define MISAKI_FONT_H

#define MISAKI_FONT_F0_PAGE 0xF0
#define MISAKI_FONT_F1_PAGE 0xF1
#define MISAKI_FONT_F2_PAGE 0xF2

#define MISAKI_FONT_F0_W 8
#define MISAKI_FONT_F1_W 3
#define MISAKI_FONT_F2_W 7

#define MISAKI_FONT_F0_SIZE 0xEF
#define MISAKI_FONT_F1_SIZE 0x9D
#define MISAKI_FONT_F2_SIZE 0x22 // misaki_font_f2.h の最終行の値をここに設定する、最大0xEFまで
PROGMEM const uint8_t misaki_font_0x00[1] = { 0x00 };
#define MISAKI_FONT_F0_H
PROGMEM const uint8_t misaki_font_f0[ MISAKI_FONT_F0_SIZE + 1 ][ MISAKI_FONT_F0_W ] =
{
  { 0x00, 0x00, 0x00, 0x00, 0x00, 0x00, 0x00, 0x00 }, /* 0x00 　 */
  { 0x20, 0x40, 0x00, 0x00, 0x00, 0x00, 0x00, 0x00 }, /* 0x01 、 */
  { 0x20, 0x50, 0x20, 0x00, 0x00, 0x00, 0x00, 0x00 }, /* 0x02 。 */
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  { 0x08, 0x08, 0x08, 0x08, 0x08, 0x08, 0x08, 0x08 }, /* 0xEF ― */
};

#define MISAKI_FONT_F1_H
PROGMEM const uint8_t misaki_font_f1[ MISAKI_FONT_F1_SIZE + 1 ][ MISAKI_FONT_F1_W ] =
{
  { 0x00, 0x00, 0x00 }, /* 0x00 */
  { 0x00, 0x2f, 0x00 }, /* 0x01 ! */
  { 0x03, 0x00, 0x03 }, /* 0x02 " */
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  { 0x02, 0x05, 0x02 }, /* 0x9D ﾟ */
};
#define MISAKI_FONT_F2_H
PROGMEM const uint8_t misaki_font_f2[ MISAKI_FONT_F2_SIZE + 1 ][ MISAKI_FONT_F2_W ] =
{
  { 0x75, 0x40, 0x77, 0x55, 0x75, 0x77, 0x40 }, /* 0x00 温 */
  { 0x40, 0x3e, 0x4a, 0x5e, 0x2b, 0x5e, 0x4a }, /* 0x01 度 */
  { 0x6b, 0x62, 0x7f, 0x35, 0x2f, 0x35, 0x7f }, /* 0x02 調 */
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  { 0x7e, 0x02, 0x3a, 0x2b, 0x3a, 0x42, 0x7e }, /* 0x22 向 */
};
/*
  プリセット
  温度調節
  タイマー
  コントロール
  スクリーン
  ブザー
  低電圧アラーム
  言語
  戻る
  取り替える
  キャリブレーション
  名前を変更
  削除
  追加
  保存
  デフォルト
  睡眠
  ブースト
  保存
  睡眠
  閉じる
  ブースト
  保存
  ダイレクト
  PID
  ビッグ
  ニュース
  閉じる
  開く
  いいえ、
  はい、
  中国語
  英語
  いいえ、
  はい、
  メインスクリーン
  フリップ
  保存
  アバウト
  日本語
  つまみ方向

  汉字转换表:温度調節低電圧言語戻取替名前変更削除追加保存睡眠閉開中国英日本密碼
*/
const char JP_0[] PROGMEM  = { 0xf0, 0xcc, 0xdf, 0xb0, 0xb8, 0xbd, };
const char JP_1[] PROGMEM  = { 0xf2, 0x00, 0x01, 0x02, 0x03, };
const char JP_2[] PROGMEM  = { 0xf0, 0xb4, 0x99, 0xd3, 0xee, };
const char JP_3[] PROGMEM  = { 0xf0, 0xa8, 0xe8, 0xbd, 0xe2, 0xee, 0xe0, };
const char JP_4[] PROGMEM  = { 0xf0, 0xae, 0xa4, 0xdf, 0xee, 0xe8, };
const char JP_5[] PROGMEM  = { 0xf0, 0xcb, 0xab, 0xee, };
const char JP_6[] PROGMEM  = { 0xf2, 0x04, 0x05, 0x06, 0xf0, 0x97, 0xde, 0xee, 0xd5, };
const char JP_7[] PROGMEM  = { 0xf2, 0x07, 0x08, };
const char JP_8[] PROGMEM  = { 0xf2, 0x09, 0xf0, 0x8d, };
const char JP_9[] PROGMEM  = { 0xf2, 0x0a, 0xf0, 0x8c, 0xf2, 0x0b, 0xf0, 0x4a, 0x8d, };
const char JP_10[] PROGMEM = { 0xf0, 0xa2, 0xd8, 0xdf, 0xcb, 0xe1, 0xee, 0xac, 0xdc, 0xe8, };
const char JP_11[] PROGMEM = { 0xf2, 0x0c, 0x0d, 0xf0, 0x94, 0xf2, 0x0e, 0x0f, };
const char JP_12[] PROGMEM = { 0xf2, 0x10, 0x11, };
const char JP_13[] PROGMEM = { 0xf2, 0x12, 0x13, };
const char JP_14[] PROGMEM = { 0xf2, 0x14, 0x15, };
const char JP_15[] PROGMEM = { 0xf0, 0xbc, 0xca, 0x9e, 0xe0, 0xbd, };
const char JP_16[] PROGMEM = { 0xf2, 0x16, 0x17, };
const char JP_17[] PROGMEM = { 0xf0, 0xcb, 0xee, 0xae, 0xbd, };
const char JP_18[] PROGMEM = { 0xf2, 0x14, 0x15, };
const char JP_19[] PROGMEM = { 0xf2, 0x16, 0x17, };
const char JP_20[] PROGMEM = { 0xf2, 0x18, 0xf0, 0x5a, 0x8d, };
const char JP_21[] PROGMEM = { 0xf0, 0xcb, 0xee, 0xae, 0xbd, };
const char JP_22[] PROGMEM = { 0xf2, 0x14, 0x15, };
const char JP_23[] PROGMEM = { 0xf0, 0xb5, 0x99, 0xe1, 0xa4, 0xbd, };
const char JP_24[] PROGMEM = { 0xf1, 0x30, 0x29, 0x24, };
const char JP_25[] PROGMEM = { 0xf0, 0xc8, 0xb8, 0xa5, };
const char JP_26[] PROGMEM = { 0xf0, 0xc0, 0xda, 0xee, 0xae, };
const char JP_27[] PROGMEM = { 0xf2, 0x18, 0xf0, 0x5a, 0x8d, };
const char JP_28[] PROGMEM = { 0xf2, 0x19, 0xf0, 0x51, };
const char JP_29[] PROGMEM = { 0xf0, 0x46, 0x46, 0x4a, 0x01, };
const char JP_30[] PROGMEM = { 0xf0, 0x71, 0x46, 0x01, };
const char JP_31[] PROGMEM = { 0xf2, 0x1a, 0x1b, 0x08, };
const char JP_32[] PROGMEM = { 0xf2, 0x1c, 0x08, };
const char JP_33[] PROGMEM = { 0xf0, 0x46, 0x46, 0x4a, 0x01, };
const char JP_34[] PROGMEM = { 0xf0, 0x71, 0x46, 0x01, };
const char JP_35[] PROGMEM = { 0xf0, 0xd6, 0x99, 0xe8, 0xae, 0xa4, 0xdf, 0xee, 0xe8, };
const char JP_36[] PROGMEM = { 0xf0, 0xca, 0xdf, 0xb8, 0xcc, };
const char JP_37[] PROGMEM = { 0xf2, 0x14, 0x15, };
const char JP_38[] PROGMEM = { 0xf0, 0x97, 0xc5, 0x9b, 0xbd, };
const char JP_39[] PROGMEM = { 0xf2, 0x1d, 0x1e, 0x08, };
const char JP_40[] PROGMEM = { 0xf2, 0x1f, 0x20, }; //密码
const char JP_41[] PROGMEM = { 0xf0, 0x66, 0x80, 0x81, 0xf2, 0x21, 0x22, }; //つまみ方向
const char *const JP_table[] = {JP_0, JP_1, JP_2, JP_3, JP_4, JP_5, JP_41, JP_6, JP_40, JP_7, JP_38, JP_8, JP_9, JP_10, JP_11, JP_12, JP_13, JP_14, JP_15, JP_16, JP_17, JP_18, JP_19, JP_20, JP_21, JP_22, JP_23, JP_24, JP_25, JP_26, JP_27, JP_28, JP_29, JP_30, JP_31, JP_32, JP_39, JP_35, JP_36, JP_37,};
const char JP_Length_table[] PROGMEM = {6, 5, 5, 7, 6, 4, 7, 9, 3, 3 , 5, 4, 9,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 3,};
#endif

/*
  8x8 dot Japanese font for Arduboy

  Copyright (c) 2016 emutyworks

  Released under the MIT license
  https://github.com/emutyworks/8x8DotJPFont/blob/master/LICENSE.txt
*/
#if LANG_JP_State
void drawText(uint8_t x, uint8_t y, const uint8_t *mes, uint8_t cnt)
{
  uint8_t pb;
  uint8_t page;
  uint8_t screen_start = 0;
  uint8_t screen_end = 128;

  if (x < screen_start) {
    x = screen_start;
  }

  for (uint8_t i = 0; i < cnt; i++) {
    pb = pgm_read_byte_near(mes + i);

    switch (pb) {
      case MISAKI_FONT_F0_PAGE:
        page = MISAKI_FONT_F0_PAGE;
        continue;
      case MISAKI_FONT_F1_PAGE:
        page = MISAKI_FONT_F1_PAGE;
        continue;
      case MISAKI_FONT_F2_PAGE:
        page = MISAKI_FONT_F2_PAGE;
        continue;
    }

    if (!page) {
      continue;
    }

    switch (page) {
#ifdef MISAKI_FONT_F0_H
      case MISAKI_FONT_F0_PAGE:
        if (pb > MISAKI_FONT_F0_SIZE) {
          continue;
        }
        if ((x + 8) > screen_end) {
          x = screen_start;
          y = y + 8;
        }
        arduboy.drawBitmap(x, y,  misaki_font_f0[ pb ], MISAKI_FONT_F0_W, 8, WHITE);
        x = x + 8;
        break;
#endif
#ifdef MISAKI_FONT_F1_H
      case MISAKI_FONT_F1_PAGE:
        if (pb > MISAKI_FONT_F1_SIZE) {
          continue;
        }
        if ((x + 4) > screen_end) {
          x = screen_start;
          y = y + 8;
        }
        arduboy.drawBitmap(x, y,  misaki_font_f1[ pb ], MISAKI_FONT_F1_W, 8, WHITE);
        arduboy.drawBitmap(x + 3, y, misaki_font_0x00, 1, 8, WHITE);
        x = x + 4;
        break;
#endif
#ifdef MISAKI_FONT_F2_H
      case MISAKI_FONT_F2_PAGE:
        if (pb > MISAKI_FONT_F2_SIZE) {
          continue;
        }
        if ((x + 8) > screen_end) {
          x = screen_start;
          y = y + 8;
        }
        arduboy.drawBitmap(x, y,  misaki_font_f2[ pb ], MISAKI_FONT_F2_W, 8, WHITE);
        arduboy.drawBitmap(x + 7, y, misaki_font_0x00, 1, 8, WHITE);
        x = x + 8;
        break;
#endif
    }
  }
}
#endif
